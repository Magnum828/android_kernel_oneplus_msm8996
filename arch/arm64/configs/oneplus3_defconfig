## arch/arm64/configs/oneplus3_defconfig
```kconfig
CONFIG_ANDROID=y
CONFIG_ANDROID_BINDER_IPC=y
CONFIG_ANDROID_LMK_ADJ_RBTREE=y
CONFIG_ANDROID_LOW_MEMORY_KILLER=y
CONFIG_ANDROID_TIMED_GPIO=y
CONFIG_APSS_CORE_EA=y
CONFIG_ARCH_MMAP_RND_COMPAT_BITS=16
CONFIG_ARCH_MSM8996=y
CONFIG_ARCH_MSM=y
CONFIG_ARM64_CRYPTO=y
CONFIG_ARMV8_DEPRECATED=y
CONFIG_ARM_GIC_V3_ACL=y
CONFIG_ARM_SMMU=y
CONFIG_ASHMEM=y
CONFIG_AT76C50X_USB=m
CONFIG_ATH5K=m
CONFIG_ATH5K_PCI=y
CONFIG_ATH6KL=m
CONFIG_ATH6KL_USB=m
CONFIG_ATH9K=m
CONFIG_ATH9K_BTCOEX_SUPPORT=y
CONFIG_ATH9K_COMMON=m
CONFIG_ATH9K_HTC=m
CONFIG_ATH9K_HW=m
CONFIG_ATH9K_RFKILL=y
CONFIG_ATH_CARDS=y
CONFIG_ATH_COMMON=m
CONFIG_ATL1C=y
CONFIG_ATMEL=m
CONFIG_AUDIT=y
CONFIG_AVERAGE=y
CONFIG_BACKLIGHT_LCD_SUPPORT=y
CONFIG_BATTERY_BCL=y
CONFIG_BLK_DEV_DM=y
CONFIG_BLK_DEV_INITRD=y
CONFIG_BLK_DEV_LOOP=y
CONFIG_BLK_DEV_RAM=y
CONFIG_BLK_DEV_RAM_SIZE=8192
CONFIG_BLK_DEV_SD=y
CONFIG_BONDING=y
CONFIG_BRIDGE=y
CONFIG_BRIDGE_EBT_BROUTE=y
CONFIG_BRIDGE_NF_EBTABLES=y
CONFIG_BT=y
CONFIG_BT_ATH3K=y
CONFIG_BT_BNEP=y
CONFIG_BT_BNEP_MC_FILTER=y
CONFIG_BT_BNEP_PROTO_FILTER=y
CONFIG_BT_HCIBCM203X=y
CONFIG_BT_HCIBFUSB=y
CONFIG_BT_HCIBPA10X=y
CONFIG_BT_HCIBTUSB=y
CONFIG_BT_HCIUART=y
CONFIG_BT_HIDP=y
CONFIG_BT_RFCOMM=y
CONFIG_BT_RFCOMM_TTY=y
CONFIG_BUILD_ARM64_APPENDED_DTB_IMAGE=y
CONFIG_BUS_AUTO_SUSPEND=y
CONFIG_BUS_TOPOLOGY_ADHOC=y
CONFIG_CC_STACKPROTECTOR_STRONG=y
CONFIG_CFG80211=y
CONFIG_CFG80211_INTERNAL_REGDB=y
CONFIG_CFG80211_WEXT=y
CONFIG_CGROUPS=y
CONFIG_CGROUP_CPUACCT=y
CONFIG_CGROUP_FREEZER=y
CONFIG_CGROUP_SCHED=y
CONFIG_CHR_DEV_SCH=y
CONFIG_CHR_DEV_SG=y
CONFIG_CLD_LL_CORE=y
CONFIG_CLS_U32_MARK=y
CONFIG_CMA=y
CONFIG_CMA_DEBUGFS=y
CONFIG_CNSS=y
CONFIG_CNSS_CRYPTO=y
CONFIG_COMPAT=y
CONFIG_CPU_BOOST=y
CONFIG_CPU_FREQ=y
CONFIG_CPU_FREQ_GOV_INTERACTIVE=y
CONFIG_CPU_FREQ_GOV_POWERSAVE=y
CONFIG_CPU_FREQ_STAT_DETAILS=y
CONFIG_CPU_IDLE=y
CONFIG_CRC_ITU_T=m
CONFIG_CRYPTO_AES_ARM64_CE_BLK=y
CONFIG_CRYPTO_AES_ARM64_CE_CCM=y
CONFIG_CRYPTO_AES_ARM64_NEON_BLK=y
CONFIG_CRYPTO_CCM=m
CONFIG_CRYPTO_CHACHA20POLY1305=y
CONFIG_CRYPTO_CHACHA20_NEON=y
CONFIG_CRYPTO_CRC32_ARM64_CE=y
CONFIG_CRYPTO_DEV_OTA_CRYPTO=y
CONFIG_CRYPTO_DEV_QCEDEV=y
CONFIG_CRYPTO_DEV_QCOM_ICE=y
CONFIG_CRYPTO_DEV_QCOM_MSM_QCE=y
CONFIG_CRYPTO_DEV_QCRYPTO=y
CONFIG_CRYPTO_GHASH_ARM64_CE=y
CONFIG_CRYPTO_MD4=y
CONFIG_CRYPTO_NULL=y
CONFIG_CRYPTO_SHA1_ARM64_CE=y
CONFIG_CRYPTO_SHA2_ARM64_CE=y
CONFIG_CRYPTO_TWOFISH=y
CONFIG_CRYPTO_XCBC=y
CONFIG_CYPRESS_FIRMWARE=m
CONFIG_DEFAULT_NOOP=y
CONFIG_DEFAULT_WESTWOOD=y
CONFIG_DEVFREQ_SPDM=y
CONFIG_DIAG_CHAR=y
CONFIG_DIAG_OVER_USB=y
CONFIG_DMADEVICES=y
CONFIG_DMA_CMA=y
CONFIG_DM_CRYPT=y
CONFIG_DM_REQ_CRYPT=y
CONFIG_DM_UEVENT=y
CONFIG_DUMMY=y
CONFIG_DVB_A8293=m
CONFIG_DVB_AF9013=m
CONFIG_DVB_AF9033=m
CONFIG_DVB_AS102=m
CONFIG_DVB_AS102_FE=m
CONFIG_DVB_AU8522=m
CONFIG_DVB_AU8522_DTV=m
CONFIG_DVB_AU8522_V4L=m
CONFIG_DVB_B2C2_FLEXCOP=m
CONFIG_DVB_B2C2_FLEXCOP_USB=m
CONFIG_DVB_BCM3510=m
CONFIG_DVB_CORE=y
CONFIG_DVB_CX22700=m
CONFIG_DVB_CX24116=m
CONFIG_DVB_CX24123=m
CONFIG_DVB_CXD2820R=m
CONFIG_DVB_DRX39XYJ=m
CONFIG_DVB_DRXD=m
CONFIG_DVB_DRXK=m
CONFIG_DVB_EC100=m
CONFIG_DVB_ISL6421=m
CONFIG_DVB_ISL6423=m
CONFIG_DVB_LG2160=m
CONFIG_DVB_LGDT330X=m
CONFIG_DVB_LGDT3305=m
CONFIG_DVB_LNBP21=m
CONFIG_DVB_M88DS3103=m
CONFIG_DVB_MAX_ADAPTERS=8
CONFIG_DVB_MB86A20S=m
CONFIG_DVB_MT312=m
CONFIG_DVB_MT352=m
CONFIG_DVB_NET=y
CONFIG_DVB_NXT200X=m
CONFIG_DVB_PLL=m
CONFIG_DVB_RTL2830=m
CONFIG_DVB_RTL2832=m
CONFIG_DVB_S5H1409=m
CONFIG_DVB_S5H1420=m
CONFIG_DVB_S921=m
CONFIG_DVB_SI2168=m
CONFIG_DVB_STV0297=m
CONFIG_DVB_STV0299=m
CONFIG_DVB_STV0900=m
CONFIG_DVB_STV6110=m
CONFIG_DVB_TDA1004X=m
CONFIG_DVB_TDA8083=m
CONFIG_DVB_TDA10023=m
CONFIG_DVB_TDA10071=m
CONFIG_DVB_TDA18271C2DD=m
CONFIG_DVB_TTUSB_BUDGET=m
CONFIG_DVB_TTUSB_DEC=m
CONFIG_DVB_TUNER_CX24113=m
CONFIG_DVB_TUNER_ITD1000=m
CONFIG_DVB_USB_AF9015=m
CONFIG_DVB_USB_AF9035=m
CONFIG_DVB_USB_ANYSEE=m
CONFIG_DVB_USB_AU6610=m
CONFIG_DVB_USB_AZ6007=m
CONFIG_DVB_USB_CE6230=m
CONFIG_DVB_USB_DVBSKY=m
CONFIG_DVB_USB_EC168=m
CONFIG_DVB_USB_GL861=m
CONFIG_DVB_USB_MXL111SF=m
CONFIG_DVB_USB_RTL28XXU=m
CONFIG_DVB_USB_V2=m
CONFIG_DVB_VES1820=m
CONFIG_DVB_ZL10353=m
CONFIG_EEPROM_93CX6=m
CONFIG_EEPROM_AT24=y
CONFIG_EMBEDDED=y
CONFIG_ENABLE_DEFAULT_TRACERS=y
CONFIG_ENABLE_FP_SIMD_SETTINGS=y
CONFIG_ESOC=y
CONFIG_ESOC_CLIENT=y
CONFIG_ESOC_DEV=y
CONFIG_ESOC_MDM_4x=y
CONFIG_ESOC_MDM_DRV=y
CONFIG_EXT4_FS=y
CONFIG_EXT4_FS_SECURITY=y
CONFIG_F2FS_FS=y
CONFIG_F2FS_FS_ENCRYPTION=y
CONFIG_F2FS_FS_SECURITY=y
CONFIG_FB=y
CONFIG_FB_MSM=y
CONFIG_FB_MSM_MDSS=y
CONFIG_FB_MSM_MDSS_WRITEBACK=y
CONFIG_FG_BQ27541=y
CONFIG_FINGERPRINT_FPC1022=y
CONFIG_FORCE_ALLOC_FROM_DMA_ZONE=y
CONFIG_FUSB301_TYPE_C=y
CONFIG_FUSE_FS=y
CONFIG_FW_LOADER_USER_HELPER_FALLBACK=y
CONFIG_GC0339=y
CONFIG_GPIO_QPNP_PIN=y
CONFIG_GPIO_SYSFS=y
CONFIG_GPIO_USB_DETECT=y
CONFIG_HDCP_QSEECOM=y
CONFIG_HIDRAW=y
CONFIG_HID_APPLE=y
CONFIG_HID_ELECOM=y
CONFIG_HID_MAGICMOUSE=y
CONFIG_HID_MICROSOFT=y
CONFIG_HID_MULTITOUCH=y
CONFIG_HIGH_RES_TIMERS=y
CONFIG_HW_RANDOM_MSM_LEGACY=y
CONFIG_I2C_ALGOBIT=m
CONFIG_I2C_CHARDEV=y
CONFIG_I2C_MSM_V2=y
CONFIG_IMX132=y
CONFIG_IMX134=y
CONFIG_INET6_AH=y
CONFIG_INET6_ESP=y
CONFIG_INET6_IPCOMP=y
CONFIG_INET=y
CONFIG_INET_AH=y
CONFIG_INET_DIAG_DESTROY=y
CONFIG_INET_ESP=y
CONFIG_INET_IPCOMP=y
CONFIG_INPUT_EVDEV=y
CONFIG_INPUT_GPIO=y
CONFIG_INPUT_JOYSTICK=y
CONFIG_INPUT_KEYCHORD=y
CONFIG_INPUT_KEYRESET=y
CONFIG_INPUT_MISC=y
CONFIG_INPUT_TABLET=y
CONFIG_INPUT_TOUCHSCREEN=y
CONFIG_INPUT_UINPUT=y
CONFIG_IOMMU_IO_PGTABLE_FAST=y
CONFIG_ION=y
CONFIG_ION_MSM=y
CONFIG_IP6_NF_FILTER=y
CONFIG_IP6_NF_IPTABLES=y
CONFIG_IP6_NF_MANGLE=y
CONFIG_IP6_NF_MATCH_RPFILTER=y
CONFIG_IP6_NF_RAW=y
CONFIG_IP6_NF_TARGET_REJECT=y
CONFIG_IPA=y
CONFIG_IPC_ROUTER=y
CONFIG_IPC_ROUTER_SECURITY=y
CONFIG_IPV6=y
CONFIG_IPV6_MIP6=y
CONFIG_IPV6_MULTIPLE_TABLES=y
CONFIG_IPV6_OPTIMISTIC_DAD=y
CONFIG_IPV6_ROUTER_PREF=y
CONFIG_IPV6_ROUTE_INFO=y
CONFIG_IPV6_SUBTREES=y
CONFIG_IP_ADVANCED_ROUTER=y
CONFIG_IP_MULTICAST=y
CONFIG_IP_MULTIPLE_TABLES=y
CONFIG_IP_NF_ARPFILTER=y
CONFIG_IP_NF_ARPTABLES=y
CONFIG_IP_NF_ARP_MANGLE=y
CONFIG_IP_NF_FILTER=y
CONFIG_IP_NF_IPTABLES=y
CONFIG_IP_NF_MANGLE=y
CONFIG_IP_NF_MATCH_AH=y
CONFIG_IP_NF_MATCH_ECN=y
CONFIG_IP_NF_MATCH_RPFILTER=y
CONFIG_IP_NF_MATCH_TTL=y
CONFIG_IP_NF_NAT=y
CONFIG_IP_NF_RAW=y
CONFIG_IP_NF_SECURITY=y
CONFIG_IP_NF_TARGET_MASQUERADE=y
CONFIG_IP_NF_TARGET_NETMAP=y
CONFIG_IP_NF_TARGET_REDIRECT=y
CONFIG_IP_NF_TARGET_REJECT=y
CONFIG_IP_PNP=y
CONFIG_IP_PNP_DHCP=y
CONFIG_IP_ROUTE_VERBOSE=y
CONFIG_IRQ_TIME_ACCOUNTING=y
CONFIG_JOYSTICK_XPAD=y
CONFIG_JUMP_LABEL=y
CONFIG_KEYBOARD_GPIO=y
CONFIG_L2TP=y
CONFIG_L2TP_DEBUGFS=y
CONFIG_L2TP_ETH=y
CONFIG_L2TP_IP=y
CONFIG_L2TP_V3=y
CONFIG_LEDS_QPNP=y
CONFIG_LEDS_QPNP_FLASH=y
CONFIG_LEDS_QPNP_WLED=y
CONFIG_LEDS_TRIGGERS=y
CONFIG_LIMITS_LITE_HW=y
CONFIG_LIMITS_MONITOR=y
CONFIG_LOCALVERSION="-paranoidhunter"
CONFIG_LOG_CPU_MAX_BUF_SHIFT=15
CONFIG_MAC80211=m
CONFIG_MAC80211_HAS_RC=y
CONFIG_MAC80211_LEDS=y
CONFIG_MAC80211_RC_DEFAULT="minstrel_ht"
CONFIG_MAC80211_RC_DEFAULT_MINSTREL=y
CONFIG_MAC80211_RC_MINSTREL=y
CONFIG_MAC80211_RC_MINSTREL_HT=y
CONFIG_MAGIC_SYSRQ=y
CONFIG_MAGIC_SYSRQ_DEFAULT_ENABLE=0x01b6
CONFIG_MD=y
CONFIG_MEDIA_CAMERA_SUPPORT=y
CONFIG_MEDIA_COMMON_OPTIONS=y
CONFIG_MEDIA_CONTROLLER=y
CONFIG_MEDIA_DIGITAL_TV_SUPPORT=y
CONFIG_MEDIA_SUPPORT=y
CONFIG_MEDIA_TUNER=y
CONFIG_MEDIA_TUNER_E4000=m
CONFIG_MEDIA_TUNER_FC0011=m
CONFIG_MEDIA_TUNER_FC0012=m
CONFIG_MEDIA_TUNER_FC0013=m
CONFIG_MEDIA_TUNER_FC2580=m
CONFIG_MEDIA_TUNER_IT913X=m
CONFIG_MEDIA_TUNER_M88TS2022=m
CONFIG_MEDIA_TUNER_MC44S803=y
CONFIG_MEDIA_TUNER_MT20XX=y
CONFIG_MEDIA_TUNER_MT2060=m
CONFIG_MEDIA_TUNER_MT2063=m
CONFIG_MEDIA_TUNER_MXL5005S=m
CONFIG_MEDIA_TUNER_MXL5007T=m
CONFIG_MEDIA_TUNER_QT1010=m
CONFIG_MEDIA_TUNER_R820T=m
CONFIG_MEDIA_TUNER_SI2157=m
CONFIG_MEDIA_TUNER_SIMPLE=y
CONFIG_MEDIA_TUNER_TDA827X=y
CONFIG_MEDIA_TUNER_TDA8290=y
CONFIG_MEDIA_TUNER_TDA9887=y
CONFIG_MEDIA_TUNER_TDA18212=m
CONFIG_MEDIA_TUNER_TDA18218=m
CONFIG_MEDIA_TUNER_TDA18271=y
CONFIG_MEDIA_TUNER_TEA5761=y
CONFIG_MEDIA_TUNER_TEA5767=y
CONFIG_MEDIA_TUNER_TUA9001=m
CONFIG_MEDIA_TUNER_XC2028=y
CONFIG_MEDIA_TUNER_XC4000=y
CONFIG_MEDIA_TUNER_XC5000=y
CONFIG_MEDIA_USB_SUPPORT=y
CONFIG_MEM_SHARE_QMI_SERVICE=y
CONFIG_MMC=y
CONFIG_MMC_BLOCK_MINORS=32
CONFIG_MMC_CLKGATE=y
CONFIG_MMC_CQ_HCI=y
CONFIG_MMC_PARANOID_SD_INIT=y
CONFIG_MMC_PERF_PROFILING=y
CONFIG_MMC_SDHCI=y
CONFIG_MMC_SDHCI_MSM=y
CONFIG_MMC_SDHCI_MSM_ICE=y
CONFIG_MMC_SDHCI_PLTFM=y
CONFIG_MODULE_FORCE_LOAD=y
CONFIG_MODULES=y
CONFIG_MSDOS_FS=y
CONFIG_MSMB_CAMERA=y
CONFIG_MSMB_JPEG=y
CONFIG_MSM_ADSPRPC=y
CONFIG_MSM_ADSP_LOADER=y
CONFIG_MSM_APM=y
CONFIG_MSM_APP_SETTINGS=y
CONFIG_MSM_AVTIMER=y
CONFIG_MSM_BCL_CTL=y
CONFIG_MSM_BCL_PERIPHERAL_CTL=y
CONFIG_MSM_BOOT_STATS=y
CONFIG_MSM_BT_POWER=y
CONFIG_MSM_BUS_SCALING=y
CONFIG_MSM_CACHE_M4M_ERP64=y
CONFIG_MSM_CAMERA=y
CONFIG_MSM_CAMERA_SENSOR=y
CONFIG_MSM_CCI=y
CONFIG_MSM_CLK_CONTROLLER_V2=y
CONFIG_MSM_CPP=y
CONFIG_MSM_CSI20_HEADER=y
CONFIG_MSM_CSI22_HEADER=y
CONFIG_MSM_CSI30_HEADER=y
CONFIG_MSM_CSI31_HEADER=y
CONFIG_MSM_CSID=y
CONFIG_MSM_CSIPHY=y
CONFIG_MSM_DLOAD_MODE=y
CONFIG_MSM_EEPROM=y
CONFIG_MSM_EVENT_TIMER=y
CONFIG_MSM_FD=y
CONFIG_MSM_FORCE_WDOG_BITE_ON_PANIC=y
CONFIG_MSM_GLINK=y
CONFIG_MSM_GLINK_LOOPBACK_SERVER=y
CONFIG_MSM_GLINK_PKT=y
CONFIG_MSM_GLINK_SMD_XPRT=y
CONFIG_MSM_GLINK_SMEM_NATIVE_XPRT=y
CONFIG_MSM_IPC_ROUTER_GLINK_XPRT=y
CONFIG_MSM_ISPIF=y
CONFIG_MSM_JPEGDMA=y
CONFIG_MSM_KERNEL_PROTECT=y
CONFIG_MSM_KGSL=y
CONFIG_MSM_L2_SPM=y
CONFIG_MSM_MDSS_PLL=y
CONFIG_MSM_MEMORY_DUMP_V2=y
CONFIG_MSM_MHI=y
CONFIG_MSM_MHI_UCI=y
CONFIG_MSM_MPM_OF=y
CONFIG_MSM_PERFORMANCE=y
CONFIG_MSM_PIL=y
CONFIG_MSM_PIL_MSS_QDSP6V5=y
CONFIG_MSM_PIL_SSR_GENERIC=y
CONFIG_MSM_PM=y
CONFIG_MSM_POWER=y
CONFIG_MSM_QBT1000=y
CONFIG_MSM_QMI_INTERFACE=y
CONFIG_MSM_QPNP_INT=y
CONFIG_MSM_QUSB_PHY=y
CONFIG_MSM_RMNET_MHI=y
CONFIG_MSM_RPM_LOG=y
CONFIG_MSM_RPM_SMD=y
CONFIG_MSM_RPM_STATS_LOG=y
CONFIG_MSM_RUN_QUEUE_STATS=y
CONFIG_MSM_SCM=y
CONFIG_MSM_SCM_ERRATA=y
CONFIG_MSM_SMD=y
CONFIG_MSM_SMD_PKT=y
CONFIG_MSM_SMEM=y
CONFIG_MSM_SMP2P=y
CONFIG_MSM_SMP2P_TEST=y
CONFIG_MSM_SPM=y
CONFIG_MSM_SPMI=y
CONFIG_MSM_SPMI_PMIC_ARB=y
CONFIG_MSM_SUBSYSTEM_RESTART=y
CONFIG_MSM_SYSMON_GLINK_COMM=y
CONFIG_MSM_TZ_LOG=y
CONFIG_MSM_V4L2_VIDEO_OVERLAY_DEVICE=y
CONFIG_MSM_VIDC_GOVERNORS=y
CONFIG_MSM_VIDC_V4L2=y
CONFIG_MSM_VIDC_VMEM=y
CONFIG_MSM_WATCHDOG_V2=y
CONFIG_NAMESPACES=y
CONFIG_NET=y
CONFIG_NETDEVICES=y
CONFIG_NETFILTER=y
CONFIG_NETFILTER_XT_MATCH_COMMENT=y
CONFIG_NETFILTER_XT_MATCH_CONNLIMIT=y
CONFIG_NETFILTER_XT_MATCH_CONNMARK=y
CONFIG_NETFILTER_XT_MATCH_CONNTRACK=y
CONFIG_NETFILTER_XT_MATCH_DSCP=y
CONFIG_NETFILTER_XT_MATCH_ESP=y
CONFIG_NETFILTER_XT_MATCH_HASHLIMIT=y
CONFIG_NETFILTER_XT_MATCH_HELPER=y
CONFIG_NETFILTER_XT_MATCH_IPRANGE=y
CONFIG_NETFILTER_XT_MATCH_LENGTH=y
CONFIG_NETFILTER_XT_MATCH_LIMIT=y
CONFIG_NETFILTER_XT_MATCH_MAC=y
CONFIG_NETFILTER_XT_MATCH_MARK=y
CONFIG_NETFILTER_XT_MATCH_MULTIPORT=y
CONFIG_NETFILTER_XT_MATCH_PKTTYPE=y
CONFIG_NETFILTER_XT_MATCH_POLICY=y
CONFIG_NETFILTER_XT_MATCH_QTAGUID=y
CONFIG_NETFILTER_XT_MATCH_QUOTA2=y
CONFIG_NETFILTER_XT_MATCH_QUOTA=y
CONFIG_NETFILTER_XT_MATCH_SOCKET=y
CONFIG_NETFILTER_XT_MATCH_STATE=y
CONFIG_NETFILTER_XT_MATCH_STATISTIC=y
CONFIG_NETFILTER_XT_MATCH_STRING=y
CONFIG_NETFILTER_XT_MATCH_TIME=y
CONFIG_NETFILTER_XT_MATCH_U32=y
CONFIG_NETFILTER_XT_TARGET_CLASSIFY=y
CONFIG_NETFILTER_XT_TARGET_CONNMARK=y
CONFIG_NETFILTER_XT_TARGET_CONNSECMARK=y
CONFIG_NETFILTER_XT_TARGET_HARDIDLETIMER=y
CONFIG_NETFILTER_XT_TARGET_IDLETIMER=y
CONFIG_NETFILTER_XT_TARGET_LOG=y
CONFIG_NETFILTER_XT_TARGET_MARK=y
CONFIG_NETFILTER_XT_TARGET_NFLOG=y
CONFIG_NETFILTER_XT_TARGET_NFQUEUE=y
CONFIG_NETFILTER_XT_TARGET_NOTRACK=y
CONFIG_NETFILTER_XT_TARGET_SECMARK=y
CONFIG_NETFILTER_XT_TARGET_TCPMSS=y
CONFIG_NETFILTER_XT_TARGET_TEE=y
CONFIG_NETFILTER_XT_TARGET_TPROXY=y
CONFIG_NETFILTER_XT_TARGET_TRACE=y
CONFIG_NET_ACT_GACT=y
CONFIG_NET_ACT_MIRRED=y
CONFIG_NET_ACT_SKBEDIT=y
CONFIG_NET_CLS_ACT=y
CONFIG_NET_CLS_FLOW=y
CONFIG_NET_CLS_FW=y
CONFIG_NET_CLS_U32=y
CONFIG_NET_EMATCH=y
CONFIG_NET_EMATCH_CMP=y
CONFIG_NET_EMATCH_META=y
CONFIG_NET_EMATCH_NBYTE=y
CONFIG_NET_EMATCH_TEXT=y
CONFIG_NET_EMATCH_U32=y
CONFIG_NET_KEY=y
CONFIG_NET_SCHED=y
CONFIG_NET_SCH_HTB=y
CONFIG_NET_SCH_INGRESS=y
CONFIG_NET_SCH_MULTIQ=y
CONFIG_NET_SCH_PRIO=y
CONFIG_NFC=y
CONFIG_NFC_NQ=y
CONFIG_NFC_PN544_OP=y
CONFIG_NF_CONNTRACK=y
CONFIG_NF_CONNTRACK_AMANDA=y
CONFIG_NF_CONNTRACK_EVENTS=y
CONFIG_NF_CONNTRACK_FTP=y
CONFIG_NF_CONNTRACK_H323=y
CONFIG_NF_CONNTRACK_IPV4=y
CONFIG_NF_CONNTRACK_IPV6=y
CONFIG_NF_CONNTRACK_IRC=y
CONFIG_NF_CONNTRACK_NETBIOS_NS=y
CONFIG_NF_CONNTRACK_PPTP=y
CONFIG_NF_CONNTRACK_SANE=y
CONFIG_NF_CONNTRACK_SECMARK=y
CONFIG_NF_CONNTRACK_TFTP=y
CONFIG_NF_CT_NETLINK=y
CONFIG_NF_CT_PROTO_DCCP=y
CONFIG_NF_CT_PROTO_SCTP=y
CONFIG_NF_CT_PROTO_UDPLITE=y
CONFIG_NLS_ASCII=y
CONFIG_NLS_CODEPAGE_437=y
CONFIG_NLS_ISO8859_1=y
CONFIG_NOP_USB_XCEIV=y
CONFIG_NO_HZ=y
CONFIG_NR_CPUS=4
CONFIG_NTFS_FS=y
CONFIG_ONEPLUS_FASTCHG=y
CONFIG_OV5648=y
CONFIG_OV8825=y
CONFIG_OV8865=y
CONFIG_OV9724=y
CONFIG_OV12830=y
CONFIG_PACKET=y
CONFIG_PANIC_ON_RECURSIVE_FAULT=y
CONFIG_PANIC_TIMEOUT=5
CONFIG_PARTITION_ADVANCED=y
CONFIG_PCI_MSM=y
CONFIG_PINCTRL_MSM8996=y
CONFIG_PM_AUTOSLEEP=y
CONFIG_PM_RUNTIME=y
CONFIG_PM_WAKELOCKS=y
CONFIG_PM_WAKELOCKS_LIMIT=0
CONFIG_POWER_RESET_MSM=y
CONFIG_PPP=y
CONFIG_PPPOE=y
CONFIG_PPPOL2TP=y
CONFIG_PPPOLAC=y
CONFIG_PPPOPNS=y
CONFIG_PPP_ASYNC=y
CONFIG_PPP_BSDCOMP=y
CONFIG_PPP_DEFLATE=y
CONFIG_PPP_FILTER=y
CONFIG_PPP_MPPE=y
CONFIG_PPP_MULTILINK=y
CONFIG_PPP_SYNC_TTY=y
CONFIG_PREEMPT=y
CONFIG_PRIMA_WLAN_11AC_HIGH_TP=y
CONFIG_PRIMA_WLAN_OKC=y
CONFIG_PRINTK_TIME=y
CONFIG_PROFILING=y
CONFIG_PSTORE=y
CONFIG_PSTORE_CONSOLE=y
CONFIG_PSTORE_PMSG=y
CONFIG_PSTORE_RAM=y
CONFIG_PTN5150_TYPE_C=y
CONFIG_PWM=y
CONFIG_PWM_QPNP=y
CONFIG_QCACLD_WLAN_LFR3=y
CONFIG_QCA_CLD_WLAN=y
CONFIG_QCA_WIFI_AUTOMOTIVE_CONC=y
CONFIG_QCOM_LTE_COEX=y
CONFIG_QCOM_SMCINVOKE=y
CONFIG_QCOM_SPS_DMA=y
CONFIG_QCOM_TDLS=y
CONFIG_QCOM_VOWIFI_11R=y
CONFIG_QMI_ENCDEC=y
CONFIG_QPNP_COINCELL=y
CONFIG_QPNP_FG=y
CONFIG_QPNP_HAPTIC=y
CONFIG_QPNP_POWER_ON=y
CONFIG_QPNP_REVID=y
CONFIG_QPNP_SMBCHARGER=y
CONFIG_QSEECOM=y
CONFIG_QUOTA=y
CONFIG_RCU_BOOST=y
CONFIG_RCU_FAST_NO_HZ=y
CONFIG_RCU_KTHREAD_PRIO=5
CONFIG_RD_BZIP2=y
CONFIG_RD_LZMA=y
CONFIG_REGULATOR=y
CONFIG_REGULATOR_CPR3_HMSS=y
CONFIG_REGULATOR_CPR3_MMSS=y
CONFIG_REGULATOR_FAN53555=y
CONFIG_REGULATOR_FIXED_VOLTAGE=y
CONFIG_REGULATOR_KRYO=y
CONFIG_REGULATOR_MEM_ACC=y
CONFIG_REGULATOR_PROXY_CONSUMER=y
CONFIG_REGULATOR_QPNP=y
CONFIG_REGULATOR_QPNP_LABIBB=y
CONFIG_REGULATOR_RPM_SMD=y
CONFIG_REGULATOR_SPM=y
CONFIG_REGULATOR_STUB=y
CONFIG_RELAY=y
CONFIG_REMOTE_SPINLOCK_MSM=y
CONFIG_RESOURCE_COUNTERS=y
CONFIG_RFKILL=y
CONFIG_RMNET_DATA=y
CONFIG_RMNET_DATA_FC=y
CONFIG_RMNET_IPA=y
CONFIG_RNDIS_IPA=y
CONFIG_RT2X00=m
CONFIG_RT2X00_LIB=m
CONFIG_RT2X00_LIB_CRYPTO=y
CONFIG_RT2X00_LIB_FIRMWARE=y
CONFIG_RT2X00_LIB_LEDS=y
CONFIG_RT2X00_LIB_USB=m
CONFIG_RT73USB=m
CONFIG_RT2500USB=m
CONFIG_RT2800USB=m
CONFIG_RT2800USB_RT33XX=y
CONFIG_RT2800USB_RT35XX=y
CONFIG_RT2800USB_RT53XX=y
CONFIG_RT2800USB_RT55XX=y
CONFIG_RT2800USB_RT3573=y
CONFIG_RT2800USB_UNKNOWN=y
CONFIG_RT2800_LIB=m
CONFIG_RTC_CLASS=y
CONFIG_RTC_DRV_QPNP=y
CONFIG_RTL8187=m
CONFIG_RTL8187_LEDS=y
CONFIG_RTL8192CU=y
CONFIG_RTL8192C_COMMON=y
CONFIG_RTLWIFI=y
CONFIG_RTLWIFI_DEBUG=y
CONFIG_RTLWIFI_USB=y
CONFIG_RTL_CARDS=m
CONFIG_RT_GROUP_SCHED=y
CONFIG_s5k4e1=y
CONFIG_SCHED_FREQ_INPUT=y
CONFIG_SCHED_HMP=y
CONFIG_SCHED_MC=y
CONFIG_SCSI=y
CONFIG_SCSI_CONSTANTS=y
CONFIG_SCSI_LOGGING=y
CONFIG_SCSI_SCAN_ASYNC=y
CONFIG_SCSI_UFSHCD=y
CONFIG_SCSI_UFSHCD_PLATFORM=y
CONFIG_SCSI_UFS_QCOM=y
CONFIG_SCSI_UFS_QCOM_ICE=y
CONFIG_SDCARD_FS=y
CONFIG_SECCOMP=y
CONFIG_SECURITY=y
CONFIG_SECURITY_NETWORK=y
CONFIG_SECURITY_SELINUX=y
CONFIG_SENSORS_EPM_ADC=y
CONFIG_SENSORS_QPNP_ADC_CURRENT=y
CONFIG_SENSORS_QPNP_ADC_VOLTAGE=y
CONFIG_SENSORS_SSC=y
CONFIG_SERIAL_MSM_HS=y
CONFIG_SERIAL_MSM_HSL=y
CONFIG_SERIAL_MSM_SMD=y
CONFIG_SLIMBUS_MSM_NGD=y
CONFIG_SMB1351_USB_CHARGER=y
CONFIG_SMP=y
CONFIG_SMS_SIANO_MDTV=m
CONFIG_SMS_USB_DRV=m
CONFIG_SND=y
CONFIG_SND_SOC=y
CONFIG_SND_SOC_MSM8996=y
CONFIG_SND_USB_AUDIO=y
CONFIG_SOCKEV_NLMCAST=y
CONFIG_SOC_CAMERA=y
CONFIG_SOC_CAMERA_PLATFORM=y
CONFIG_SOUND=y
CONFIG_SOUNDWIRE=y
CONFIG_SPDM_SCM=y
CONFIG_SPI=y
CONFIG_SPI_QUP=y
CONFIG_SPS=y
CONFIG_SPS_SUPPORT_NDP_BAM=y
CONFIG_STAGING=y
CONFIG_STRIP_ASM_SYMS=y
CONFIG_SUSPEND_TIME=y
CONFIG_SWITCH=y
CONFIG_SWP_EMULATION=y
CONFIG_SW_SYNC_USER=y
CONFIG_TASKSTATS=y
CONFIG_TASK_IO_ACCOUNTING=y
CONFIG_TASK_XACCT=y
CONFIG_TCP_CONG_ADVANCED=y
CONFIG_TCP_CONG_DCTCP=y
CONFIG_TCP_CONG_HSTCP=y
CONFIG_TCP_CONG_HYBLA=y
CONFIG_TCP_CONG_ILLINOIS=y
CONFIG_TCP_CONG_LP=y
CONFIG_TCP_CONG_SCALABLE=y
CONFIG_TCP_CONG_VENO=y
CONFIG_TCP_CONG_YEAH=y
CONFIG_THERMAL=y
CONFIG_THERMAL_MONITOR=y
CONFIG_THERMAL_QPNP=y
CONFIG_THERMAL_QPNP_ADC_TM=y
CONFIG_THERMAL_TSENS8974=y
CONFIG_TI_DRV2667=y
CONFIG_TMPFS=y
CONFIG_TMPFS_POSIX_ACL=y
CONFIG_TOUCHSCREEN_SYNAPTICS_S1302_I2C_RMI=y
CONFIG_TOUCHSCREEN_SYNAPTICS_S3320_I2C_RMI=y
CONFIG_TRACER_PKT=y
CONFIG_TRANSPARENT_HUGEPAGE=y
CONFIG_TRI_STATE_KEY=y
CONFIG_TUN=y
CONFIG_TUSB320_TYPE_C=y
CONFIG_UHID=y
CONFIG_UID_STAT=y
CONFIG_UID_SYS_STATS=y
CONFIG_UIO=y
CONFIG_UIO_MSM_SHAREDMEM=y
CONFIG_UNIX=y
CONFIG_USB_ANNOUNCE_NEW_DEVICES=y
CONFIG_USB_BAM=y
CONFIG_USB_DWC3=y
CONFIG_USB_EHCI_HCD=y
CONFIG_USB_EHSET_TEST_FIXTURE=y
CONFIG_USB_GADGET=y
CONFIG_USB_GADGET_DEBUG_FS=y
CONFIG_USB_GADGET_STORAGE_NUM_BUFFERS=4
CONFIG_USB_GADGET_VBUS_DRAW=500
CONFIG_USB_GSPCA=m
CONFIG_USB_G_ANDROID=y
CONFIG_USB_HIDDEV=y
CONFIG_USB_MON=y
CONFIG_USB_MSM_SSPHY_QMP=y
CONFIG_USB_NET_RNDIS_HOST=m
CONFIG_USB_NET_RNDIS_WLAN=m
CONFIG_USB_PWC=m
CONFIG_USB_PWC_INPUT_EVDEV=y
CONFIG_USB_RTL8150=y
CONFIG_USB_RTL8152=y
CONFIG_USB_S2255=m
CONFIG_USB_SERIAL=y
CONFIG_USB_STKWEBCAM=m
CONFIG_USB_STORAGE=y
CONFIG_USB_USBNET=y
CONFIG_USB_VIDEO_CLASS=m
CONFIG_USB_VIDEO_CLASS_INPUT_EVDEV=y
CONFIG_USB_XHCI_HCD=y
CONFIG_USB_ZD1201=m
CONFIG_USB_ZR364XX=m
CONFIG_V4L_PLATFORM_DRIVERS=y
CONFIG_VFAT_FS=y
CONFIG_VIDEO_CPIA2=m
CONFIG_VIDEO_EM28XX=m
CONFIG_VIDEO_EM28XX_ALSA=m
CONFIG_VIDEO_EM28XX_DVB=m
CONFIG_VIDEO_EM28XX_V4L2=m
CONFIG_VIDEO_MSP3400=m
CONFIG_VIDEO_MT9V011=m
CONFIG_VIDEO_SAA711X=m
CONFIG_VIDEO_TUNER=m
CONFIG_VIDEO_TVEEPROM=m
CONFIG_VIDEO_TVP5150=m
CONFIG_VIDEO_USBTV=m
CONFIG_VIDEO_V4L2_SUBDEV_API=y
CONFIG_WCD9330_CODEC=y
CONFIG_WCD9335_CODEC=y
CONFIG_WCN36XX=m
CONFIG_WCNSS_MEM_PRE_ALLOC=y
CONFIG_WIFI_CONTROL_FUNC=y
CONFIG_WIL6210=m
CONFIG_WIL6210_ISR_COR=y
CONFIG_WIL6210_PLATFORM_MSM=y
CONFIG_WIL6210_TRACING=y
CONFIG_WLAN_FEATURE_11W=y
CONFIG_WLAN_FEATURE_LPSS=y
CONFIG_WLAN_FEATURE_NAN=y
CONFIG_WQ_POWER_EFFICIENT_DEFAULT=y
CONFIG_XFRM_STATISTICS=y
CONFIG_XFRM_USER=y
```
